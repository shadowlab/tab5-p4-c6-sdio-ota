## main/Kconfig.projbuild
```kconfig
menu "Tab5 C6 OTA"

    config TAB5_C6_OTA_CHUNK_SIZE
        int "Bytes sent per OTA write"
        range 256 4096
        default 1500
        help
            Size of each write sent to the ESP32-C6. Smaller chunks are slower but more forgiving of a marginal
            SDIO link.

    config TAB5_C6_OTA_MAX_IMAGE_SIZE
        hex "Largest image the C6 can take"
        default 0x180000
        help
            Size of the OTA app slots of the C6 (M5Stack's C6 image has two of 0x180000, not verified on a stock unit).
            Bigger images are refused before anything is sent.

    config TAB5_C6_OTA_FORCE
        bool "Send the image even if the C6 reports the same version as the host"
        default n

    config TAB5_C6_OTA_VERIFY_DELAY_MS
        int "Time to let the C6 reboot before reading its version again (ms)"
        range 1000 20000
        default 4000

endmenu
```
